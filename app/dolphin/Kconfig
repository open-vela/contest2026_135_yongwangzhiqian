## app/dolphin/Kconfig
```kconfig
# SPDX-License-Identifier: Apache-2.0

config DOLPHIN
	bool "Dolphin command directory"
	default n
	depends on NSH_BUILTIN_APPS && SCHED_WAITPID
	help
		Build the dolphin command directory.  It launches only a fixed set
		of already-built BK7258 command applications; it adds no driver,
		network, or RPC implementation.

if DOLPHIN

config DOLPHIN_STACKSIZE
	int "Dolphin stack size"
	default 4096

endif

config DOLPHIN_UI
	bool "Dolphin touchscreen desktop"
	default n
	depends on BK7258_AP_CORE && GRAPHICS_LVGL && LV_USE_NUTTX
	depends on LV_USE_NUTTX_TOUCHSCREEN && VIDEO_FB && INPUT_TOUCHSCREEN && NET
	depends on !BK7258_BOARD_HAS_LVGL_UI_BINDING && !BK7258_DISPLAY_SERVICE
	select BK7258_AP_APPLICATION_LIFECYCLE
	help
		Run the local Dolphin desktop on the AP-owned NuttX framebuffer
		and touchscreen. Reuse standard VFS and network status APIs; no
		SDK dependency, cloud provisioning or NFC hardware is assumed.

if DOLPHIN_UI

config DOLPHIN_UI_STACKSIZE
	int "Dolphin UI stack size"
	default 16384
	range 8192 65536

config DOLPHIN_STORAGE_ROOT
	string "Dolphin read-only file browser root"
	default "/mnt/tf"
	help
		Use the board-mounted removable filesystem. Dolphin does not mount,
		format, create or delete files and cannot navigate above this root.

endif
```

## app/testing/bk7258/Kconfig
```kconfig
# SPDX-License-Identifier: Apache-2.0

config TESTS_BK7258_RPMSG_EXEC
	bool "BK7258 AP driver-check commands over RPMsg"
	default n
	depends on ARCH_CHIP_BK7258 && BK7258_AP_CORE && BK7258_RPTUN
	select BK7258_AP_APPLICATION_LIFECYCLE
	select NET
	select NET_RPMSG
	select NET_LOCAL
	select NET_LOCAL_STREAM
	select NETUTILS_REXECD
	select NSH_LIBRARY
	select NSH_CONSOLE
	select SYSTEM_READLINE
	select NSH_BUILTIN_APPS
	select BUILTIN
	select SYSTEM_POPEN
	select PIPES
	select LIBC_EXECFUNCS
	help
		Start the official rexecd application with AF_RPMSG after normal AP
		startup.  CP can run selected standard driver tests without an AP
		UART console.  This belongs only in explicit drivercheck profiles;
		it does not start an IPv4/IPv6 listener or run tests automatically.

config TESTS_BK7258_CMOCKA
	tristate "BK7258 CP/AP lifecycle contract tests"
	default n
	depends on TESTING_CMOCKA
	depends on ARCH_SETJMP_H
	depends on ARCH_CHIP_BK7258
	depends on ARCH_BOARD_BK7258
	depends on !BK7258_AP_CORE
	depends on BK7258_AP_CONTROL
	help
		Build the target-side CMocka contract shared by every maintained
		BK7258 physical board.  It publishes the configured board identity
		and verifies the public UART0 device contract and the versioned AP
		lifecycle and supervisor interfaces without calling vendor SDK APIs.

if TESTS_BK7258_CMOCKA

config TESTS_BK7258_CMOCKA_PRIORITY
	int "BK7258 CMocka task priority"
	default 100

config TESTS_BK7258_CMOCKA_STACKSIZE
	int "BK7258 CMocka task stack size"
	default 4096

endif
```

## nuttx/drivers/input/Kconfig.gpio_ff
```kconfig
# GPIO-backed on/off force-feedback actuator.

config INPUT_GPIO_FF

	bool "GPIO rumble force-feedback driver"
	depends on INPUT && INPUT_FF
	select SCHED_LPWORK
	default n
	help
		Expose one FF_RUMBLE effect backed by an on/off GPIO output.  Boards
		provide output and power callbacks plus bounded on/off timings.
```

## nuttx/drivers/video/Kconfig.gc2145
```kconfig
# SPDX-License-Identifier: Apache-2.0
config VIDEO_GC2145_CONTROLS
	bool "GC2145 image sensor register controls"
	depends on VIDEO_STREAM
	help
		Provide standard imgsensor controls over an errno-based, serialized
		register transport. Exposure uses sensor rows; absolute exposure time
		is not advertised without a verified sensor clock model.
```
